## drivers/input/fingerprint/Kconfig
```kconfig
# This software is contributed or developed by KYOCERA Corporation.
# (C) 2019 KYOCERA Corporation
#
# Input fingerprint drivers configuration
#

config INPUT_FINGERPRINT
	bool "Enable Fingerprint Driver Support"
	default y
	help
	  Add support for fingerprint driver.

if INPUT_FINGERPRINT
config INPUT_FINGERPRINT_FPC
	bool "Enable Fingerprint Driver Support of FPC"
	depends on INPUT_FINGERPRINT
	default n
	help
	  Add support for fingerprint driver of fpc.

config INPUT_FINGERPRINT_CANVASBIO_TSUBAKI02
	bool "Enable Fingerprint Driver Support of CANVASBIO"
	depends on INPUT_FINGERPRINT
	default n
	help
	  Add support for fingerprint driver of canvasbio.

config INPUT_FINGERPRINT_CANVASBIO_TSUBAKI03
	bool "Enable Fingerprint Driver Support of CANVASBIO"
	depends on INPUT_FINGERPRINT
	default n
	help
	  Add support for fingerprint driver of canvasbio.

config INPUT_FINGERPRINT_EGIS
	bool "Enable Fingerprint Driver Support of EGIS"
	default y
	help
	  Add support for fingerprint driver of egis.

endif

if INPUT_FINGERPRINT_FPC
config INPUT_FINGERPRINT_FPC1020
	bool "Enable Fingerprint Driver Support of FPC1020"
	default y
	help
	  Add support for fingerprint driver of fpc1020.
endif

if INPUT_FINGERPRINT_CANVASBIO_TSUBAKI02 || INPUT_FINGERPRINT_CANVASBIO_TSUBAKI03
config CANVASBIO_FINGERPRINT
	tristate "Canvasbio fp platform device"
	default y
	help
	  If say Y here to use CanvasBio fingerprint driver.

	  If unsure, say N.

config CANVASBIO_FINGERPRINT_NAVIGATION
	tristate "Canvasbio fp navigation device"
	depends on CANVASBIO_FINGERPRINT
	default y
	help
	  If say Y here, you can use fingerprint navigation.
endif

if INPUT_FINGERPRINT_EGIS
config EGIS_FINGERPRINT_NAVIGATION
	tristate "EIGS fp navigation device"
	depends on EGIS_FINGERPRINT
	default n
	help
	  If say Y here, you can use fingerprint navigation.
endif
```

## drivers/input/touchscreen/kyocera/Kconfig
```kconfig
# This software is contributed or developed by KYOCERA Corporation.
# (C) 2021 KYOCERA Corporation
#
# Touchscreen driver configuration
#
if INPUT_TOUCHSCREEN

config TOUCHSCREEN_KC
	bool "Kyocera Touch Panel Driver"
	default y
	help
	  Say Y here if you have Kyocera touch panel.

	  If unsure, say N.

	  To compile this dirver as a module, choose M here: the
	  module will be called.

config TOUCHSCREEN_KC_ILI9881
	bool "Ilitek touchpanel Driver"
	depends on I2C
	default y
	help
	  Say Y here if you have a Ilitek touchscreen.
	  This driver supports models ILI9881.

	  If unsure, say N.

#source "drivers/input/touchscreen/kyocera/ilitek_v3/Kconfig"

endif
```

## drivers/nfc/pi4io/Kconfig
```kconfig
# This software is contributed or developed by KYOCERA Corporation.
# (C) 2020 KYOCERA Corporation

config NFC_PI4IO_DEVICES
	bool "Driver for the Pericom PI4IOE5V6408 GPIO Expander"
	default y
	---help---
	  You'll have to say Y if your computer contains an I2C device that
	  you want to use under Linux.

	  You can say N here if you don't have any SPI connected to your computer.
```

## drivers/power/Kconfig
```kconfig
# This software is contributed or developed by KYOCERA Corporation.
# (C) 2020 KYOCERA Corporation
#

source "drivers/power/avs/Kconfig"
source "drivers/power/reset/Kconfig"
source "drivers/power/supply/Kconfig"
source "drivers/power/oem/Kconfig"
```

## drivers/power/oem/Kconfig
```kconfig
# This software is contributed or developed by KYOCERA Corporation.
# (C) 2020 KYOCERA Corporation
#

config OEM_HKADC
	tristate "OEM HKADC support"
	default y

config OEM_WIRELESS_CHARGER
    tristate "OEM Wireless Charger support"
	default y
```

## sound/soc/codecs/tas256x/Kconfig
```kconfig
# This software is contributed or developed by KYOCERA Corporation.
# (C) 2021 KYOCERA Corporation
#
# TI Smart Audio tas256X kernel driver
# Needed I2C and I2S bus support.

config SND_SOC_TAS256X
	tristate "Build TI TAS256X ASoC CODEC drivers"
	depends on I2C
	help
	TI Smart Audio tas256X kernel driver

config TAS2563_CODEC
	tristate "Build TI TAS256X ASoC CODEC drivers"
	depends on I2C
	help
	TI Smart Audio tas256X kernel driver

config TAS2563_MISC
	tristate "Build TI TAS256X ASoC CODEC drivers"
	depends on I2C
	help
	TI Smart Audio tas256X kernel driver

config TAS2563_REGMAP
	tristate "Build TI TAS256X ASoC CODEC drivers"
	depends on I2C
	help
	TI Smart Audio tas256X kernel driver
```
